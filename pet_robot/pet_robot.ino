// Robo eyes + orca  -  single file, just paste into Arduino IDE and upload
//
//  single tap  : change mood (default > happy > sad > angry)
//  double tap  : show the orca for 5 s, then back to the mood (touch to leave early)
//  hold ~0.8 s : go to sleep (any touch wakes)

#include <Wire.h>
#include <Adafruit_GFX.h>
#include <Adafruit_SSD1306.h>
#include <FluxGarage_RoboEyes.h>

#define SDA_PIN      5
#define SCL_PIN      6
#define TOUCH_PIN    4
#define BUZZER_PIN   3         // KY-006 "S" pin
#define OLED_ADDR    0x3C      // try 0x3D if the screen stays blank

#define DOUBLE_TAP_MS 350      // max gap between two short touches for a double tap
#define HOLD_MS       800      // keep touching this long to go to sleep
#define DEBOUNCE_MS   40
#define ORCA_MS       5000     // how long the orca stays before going back to the mood
#define ORCA_Y        -1       // orca vertical position (-1 = one row higher than before)
#define EYE_THICK     2        // > < thickness: 2 = 5 px, 3 = 7 px, 1 = 3 px

Adafruit_SSD1306 display(128, 64, &Wire, -1);
RoboEyes<Adafruit_SSD1306> eyes(display);

// ---------- Orca picture (128x64, traced from the reference image) ----------
const unsigned char orcaBitmap[] PROGMEM = {
  0x00, 0x00, 0x00, 0x00, 0x00, 0x00, 0x00, 0x00, 0x00, 0x00, 0x00, 0x00, 0x00, 0x00, 0x00, 0x00,
  0x00, 0x00, 0x00, 0x00, 0x00, 0x00, 0x00, 0x00, 0x00, 0x00, 0x00, 0x00, 0x00, 0x00, 0x00, 0x00,
  0x00, 0x00, 0x00, 0x00, 0x00, 0x00, 0x00, 0x00, 0x00, 0x00, 0x00, 0x00, 0x00, 0x00, 0x00, 0x00,
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  0x00, 0x00, 0x00, 0x00, 0x00, 0x00, 0x00, 0x00, 0x00, 0x00, 0x00, 0x00, 0x00, 0x00, 0x00, 0x00,
};

// ---------- Moods ----------
// library values: 0 = default, 3 = happy, 1 = tired/sad, 2 = angry
// (index 1 "happy" is drawn by hand as > < eyes, see drawHappy)
const uint8_t moods[] = {0, 3, 1, 2};
const uint8_t moodCount = sizeof(moods) / sizeof(moods[0]);
uint8_t moodIndex = 0;         // 0 default, 1 happy, 2 sad, 3 angry

// ---------- Notes (Hz) ----------
#define REST 0
#define C6  1047
#define E6  1319
#define G6  1568
#define A6  1760
#define C7  2093
#define D7  2349
#define E7  2637
#define F7  2794
#define FS7 2960
#define G7  3136
#define A7  3520
#define C8  4186

struct Note { int freq; int ms; };

const Note startupSnd[] = {
  {C7, 60}, {E7, 60}, {G7, 60}, {C8, 120}, {REST, 60}, {G7, 60}, {C8, 160}
};

const Note defaultSnd[] = {
  {G7, 70}, {REST, 30}, {C8, 110}, {REST, 40}, {E7, 90}
};

const Note happySnd[] = {
  {C7, 80}, {E7, 80}, {G7, 80}, {C8, 150}, {REST, 40},
  {G7, 80}, {C8, 220}, {REST, 50},
  {E7, 70}, {G7, 70}, {C8, 70}, {E7, 70}, {G7, 70}, {C8, 300}
};

const Note sadSnd[] = {
  {G7, 260}, {REST, 30}, {FS7, 260}, {REST, 30},
  {F7, 260}, {REST, 30}, {E7, 600}
};

const Note angrySnd[] = {
  {G6, 90}, {REST, 30}, {G6, 90}, {REST, 30}, {G6, 90}, {REST, 30}, {G6, 160}, {REST, 60},
  {E6, 40}, {C6, 40}, {E6, 40}, {C6, 40}, {E6, 40}, {C6, 40}, {E6, 40}, {C6, 40},
  {E6, 40}, {C6, 40}, {E6, 40}, {C6, 40}, {REST, 50},
  {E7, 60}, {G7, 60}, {A7, 60}, {C8, 120}, {REST, 30},
  {C8, 50}, {A7, 50}, {C8, 50}, {A7, 50}, {C8, 50}, {A7, 50},
  {G7, 60}, {F7, 60}, {E7, 60}, {D7, 60}, {C7, 60}, {A6, 300}
};

const Note sleepSnd[] = {
  {E7, 180}, {REST, 20}, {C7, 180}, {REST, 20}, {G6, 180}, {REST, 20}, {C6, 450}
};

const Note wakeSnd[] = {
  {C6, 70}, {G6, 70}, {C7, 70}, {E7, 70}, {G7, 120}
};

// whale-call style chirps: up, up, down, long low note
const Note orcaSnd[] = {
  {A6, 90}, {C7, 90}, {E7, 90}, {G7, 140}, {REST, 50},
  {G7, 90}, {E7, 90}, {C7, 90}, {REST, 60},
  {A6, 220}, {REST, 30}, {C6, 380}
};

#define LEN(a) (sizeof(a) / sizeof(a[0]))

const Note* seq = nullptr;
uint8_t seqLen = 0, seqPos = 0;
unsigned long nextNoteAt = 0;

// ---------- Buzzer (works on ESP32 core 2.x and 3.x) ----------
void buzzerSetup() {
#if ESP_ARDUINO_VERSION_MAJOR >= 3
  ledcAttach(BUZZER_PIN, 2000, 8);
#else
  ledcSetup(0, 2000, 8);
  ledcAttachPin(BUZZER_PIN, 0);
#endif
}

void buzzerTone(int freq) {
#if ESP_ARDUINO_VERSION_MAJOR >= 3
  ledcWriteTone(BUZZER_PIN, freq);
#else
  ledcWriteTone(0, freq);
#endif
}

void playSeq(const Note* s, uint8_t len) {
  seq = s;
  seqLen = len;
  seqPos = 0;
  nextNoteAt = 0;
}

// non-blocking: one note at a time so the screen never freezes
void updateSound() {
  if (!seqLen || millis() < nextNoteAt) return;

  if (seqPos >= seqLen) {
    buzzerTone(0);
    seqLen = 0;
    return;
  }
  buzzerTone(seq[seqPos].freq);
  nextNoteAt = millis() + seq[seqPos].ms;
  seqPos++;
}

void playMoodSound(uint8_t index) {
  switch (index) {
    case 0: playSeq(defaultSnd, LEN(defaultSnd)); break;
    case 1: playSeq(happySnd,   LEN(happySnd));   break;
    case 2: playSeq(sadSnd,     LEN(sadSnd));     break;
    case 3: playSeq(angrySnd,   LEN(angrySnd));   break;
  }
}

// ---------- Eye looks ----------
void applyMood(uint8_t index) {
  // reset everything back to normal first
  eyes.setHFlicker(OFF, 0);
  eyes.setVFlicker(OFF, 0);
  eyes.setWidth(36, 36);
  eyes.setHeight(36, 36);
  eyes.setBorderradius(8, 8);
  eyes.setIdleMode(ON, 2, 2);

  eyes.setMood(moods[index]);

  if (index == 3) {                 // angry: heavy brows, shaking with rage
    eyes.setHeight(28, 28);
    eyes.setBorderradius(3, 3);
    eyes.setIdleMode(OFF, 0, 0);
    eyes.setPosition(0);
    eyes.setHFlicker(ON, 2);
  }
}

// ---------- Happy face: > < eyes ----------
// thick chevron made from several parallel lines (set EYE_THICK at the top)
void thickLine(int x0, int y0, int x1, int y1) {
  for (int t = -EYE_THICK; t <= EYE_THICK; t++) display.drawLine(x0, y0 + t, x1, y1 + t, SSD1306_WHITE);
}

unsigned long lastHappyFrame = 0;
uint8_t happyPhase = 0;

void drawHappy() {
  if (millis() - lastHappyFrame < 120) return;
  lastHappyFrame = millis();
  happyPhase++;
  int bounce = (happyPhase % 4 < 2) ? 0 : 2;      // little happy bounce

  display.clearDisplay();
  // left eye  ">"
  thickLine(22, 14 + bounce, 46, 32 + bounce);
  thickLine(46, 32 + bounce, 22, 50 + bounce);
  // right eye "<"
  thickLine(106, 14 + bounce, 82, 32 + bounce);
  thickLine(82, 32 + bounce, 106, 50 + bounce);
  display.display();
}

// ---------- Orca face (double tap) ----------
bool orcaMode = false;
unsigned long lastOrcaFrame = 0;
unsigned long orcaStart = 0;
uint8_t orcaPhase = 0;

void updateOrca() {
  if (millis() - lastOrcaFrame < 400) return;
  lastOrcaFrame = millis();
  orcaPhase++;
  int bob = (orcaPhase % 2) ? 1 : 0;              // gentle floating
  display.clearDisplay();
  display.drawBitmap(0, ORCA_Y + bob, orcaBitmap, 128, 64, SSD1306_WHITE);
  display.display();
}

// ---------- Sleep / wake ----------
bool asleep = false;

void goToSleep() {
  asleep = true;
  orcaMode = false;
  playSeq(sleepSnd, LEN(sleepSnd));
  display.clearDisplay();
  display.display();
  display.ssd1306_command(SSD1306_DISPLAYOFF);
}

void wakeUp() {
  asleep = false;
  display.ssd1306_command(SSD1306_DISPLAYON);
  moodIndex = 0;
  applyMood(moodIndex);
  playSeq(wakeSnd, LEN(wakeSnd));
}

// ---------- Touch ----------
bool lastTouch = false;
unsigned long lastEdge = 0;
unsigned long pressStart = 0;
bool held = false;                 // this press already became a hold (sleep)
bool pendingTap = false;           // waiting to see if a 2nd tap follows
unsigned long pendingTapTime = 0;

void setup() {
  pinMode(TOUCH_PIN, INPUT);
  buzzerSetup();
  buzzerTone(0);

  Wire.begin(SDA_PIN, SCL_PIN);
  display.begin(SSD1306_SWITCHCAPVCC, OLED_ADDR);

  eyes.begin(128, 64, 100);
  eyes.setAutoblinker(ON, 3, 2);
  applyMood(moodIndex);

  playSeq(startupSnd, LEN(startupSnd));
}

void loop() {
  bool touch = digitalRead(TOUCH_PIN);
  unsigned long now = millis();

  // finger just touched
  if (touch && !lastTouch && now - lastEdge > DEBOUNCE_MS) {
    lastEdge = now;
    pressStart = now;
    held = false;
  }

  // finger kept on the sensor: go to sleep
  if (touch && lastTouch && !held && !asleep && now - pressStart >= HOLD_MS) {
    held = true;
    pendingTap = false;
    goToSleep();
  }

  // finger lifted
  if (!touch && lastTouch && now - lastEdge > DEBOUNCE_MS) {
    lastEdge = now;

    if (held) {
      // that press was a hold, nothing more to do
    } else if (asleep) {
      wakeUp();                                    // any touch wakes him
      pendingTap = false;
    } else if (orcaMode) {
      orcaMode = false;                            // touch leaves the orca
      pendingTap = false;
      applyMood(moodIndex);
    } else if (pendingTap && now - pendingTapTime <= DOUBLE_TAP_MS) {
      pendingTap = false;                          // second tap = orca
      orcaMode = true;
      orcaPhase = 0;
      lastOrcaFrame = 0;
      orcaStart = now;
      playSeq(orcaSnd, LEN(orcaSnd));
    } else {
      pendingTap = true;                           // maybe the first of two
      pendingTapTime = now;
    }
  }
  lastTouch = touch;

  // no second tap arrived: it was a single tap, change the mood
  if (pendingTap && !touch && now - pendingTapTime > DOUBLE_TAP_MS) {
    pendingTap = false;
    moodIndex = (moodIndex + 1) % moodCount;
    applyMood(moodIndex);
    playMoodSound(moodIndex);
  }

  // orca has been on screen long enough: back to the mood
  if (orcaMode && now - orcaStart >= ORCA_MS) {
    orcaMode = false;
    applyMood(moodIndex);
  }

  updateSound();
  if (asleep) return;
  if (orcaMode) updateOrca();
  else if (moodIndex == 1) drawHappy();
  else eyes.update();
}